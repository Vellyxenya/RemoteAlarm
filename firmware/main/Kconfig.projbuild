## firmware/main/Kconfig.projbuild
```kconfig
menu "Remote Alarm Configuration"

    config EXAMPLE_WIFI_SSID
        string "WiFi SSID"
        default "YOUR_WIFI_SSID"
        help
            SSID of the WiFi network the ESP32 should connect to.

    config EXAMPLE_WIFI_PASSWORD
        string "WiFi Password"
        default "YOUR_WIFI_PASSWORD"
        help
            Password of the WiFi network.

    config MQTT_BROKER_URL
        string "MQTT Broker URL"
        default "mqtts://hivemq-broker"
        help
            URL of the MQTT broker.

    config MQTT_USERNAME
        string "MQTT Username"
        default "esp32-device1"

    config MQTT_PASSWORD
        string "MQTT Password"
        default "WakeupCeleste1"

    config MQTT_TOPIC
        string "MQTT Topic"
        default "home/audio/device1"

endmenu
```

## firmware/sdkconfig.defaults.template
```kconfig
CONFIG_FREERTOS_ENABLE_BACKWARD_COMPATIBILITY=y
CONFIG_MBEDTLS_CERTIFICATE_BUNDLE=y
CONFIG_MBEDTLS_CERTIFICATE_BUNDLE_DEFAULT_FULL=y

# Disable all predefined audio boards
CONFIG_ESP_LYRAT_V4_3_BOARD=n
CONFIG_ESP_LYRAT_V4_2_BOARD=n
CONFIG_ESP_LYRATD_MSC_V2_1_BOARD=n
CONFIG_ESP_LYRATD_MSC_V2_2_BOARD=n
CONFIG_ESP_LYRAT_MINI_V1_1_BOARD=n

# Enable custom board
CONFIG_AUDIO_BOARD_CUSTOM=y
CONFIG_IDF_TARGET="esp32s3"
CONFIG_SPIRAM_MODE_OCT=y
CONFIG_SPIRAM_TYPE_AUTO=y

# Set Connectivity params
CONFIG_EXAMPLE_WIFI_SSID="YOUR_WIFI_SSID"
CONFIG_EXAMPLE_WIFI_PASSWORD="YOUR_WIFI_PASSWORD"
CONFIG_MQTT_BROKER_URL="mqtts://YOUR_HIVEMQ_URL:8883"
CONFIG_MQTT_USERNAME="YOUR_MQTT_USERNAME"
CONFIG_MQTT_PASSWORD="YOUR_MQTT_PASSWORD"
CONFIG_MQTT_TOPIC="home/audio/device1"
```
